## CMakeLists.txt
```
# TinyOTA example for Zephyr / nRF Connect SDK with MCUboot
cmake_minimum_required(VERSION 3.20.0)
find_package(Zephyr REQUIRED HINTS $ENV{ZEPHYR_BASE})
project(tinyota_zephyr_example)

set(SDK ${CMAKE_CURRENT_LIST_DIR}/../..)

target_sources(app PRIVATE
    src/main.c
    ${SDK}/src/fota_fsm.c
    ${SDK}/src/fota_common.c
    ${SDK}/src/fota_hal_nrf52.c
    ${SDK}/src/fota_platform_nrf52.c
)
target_include_directories(app PRIVATE
    src                 # tinyota_config.h
    ${SDK}/include
)
```

## prj.conf
```kconfig
# Bootloader + image slots
CONFIG_BOOTLOADER_MCUBOOT=y
CONFIG_IMG_MANAGER=y
CONFIG_FLASH=y
CONFIG_FLASH_MAP=y
CONFIG_STREAM_FLASH=y
CONFIG_MCUBOOT_IMG_MANAGER=y
CONFIG_REBOOT=y

# Networking + HTTPS. Your board also needs a network interface
# (nRF91 LTE, nRF7002 Wi-Fi, Ethernet, or OpenThread with a border router).
CONFIG_NETWORKING=y
CONFIG_NET_SOCKETS=y
CONFIG_NET_SOCKETS_SOCKOPT_TLS=y
CONFIG_DNS_RESOLVER=y
CONFIG_HTTP_CLIENT=y
CONFIG_TLS_CREDENTIALS=y
CONFIG_MBEDTLS=y
CONFIG_MBEDTLS_BUILTIN=y
CONFIG_MBEDTLS_ENABLE_HEAP=y
CONFIG_MBEDTLS_HEAP_SIZE=65536

# The FSM buffers the image in heap (see PORTING_GUIDE.md, RAM budget)
CONFIG_HEAP_MEM_POOL_SIZE=131072
CONFIG_MAIN_STACK_SIZE=8192

CONFIG_LOG=y
```

## src/main.c
```c
/*
 * TinyOTA example for Zephyr / nRF Connect SDK + MCUboot.
 *
 * Boot -> confirm this image with MCUboot -> wait for the network ->
 * register (same serial returns the same device) -> check every hour.
 * On success the SDK marks slot 1 for upgrade and reboots; MCUboot swaps.
 *
 * Not yet tested on hardware.
 */
#include <string.h>

#include <zephyr/dfu/mcuboot.h>
#include <zephyr/kernel.h>
#include <zephyr/logging/log.h>
#include <zephyr/net/tls_credentials.h>

#include "fota_fsm.h"
#include "fota_hal.h"
#include "fota_platform.h"
#include "tinyota_config.h"   /* copy tinyota_config.example.h and fill it in */

LOG_MODULE_REGISTER(app, LOG_LEVEL_INF);

#define FOTA_TLS_TAG 42       /* must match fota_platform_nrf52.c */

static const char root_ca[] = TINYOTA_ROOT_CA_PEM;
static char token[768];

static bool register_device(void)
{
    char serial[32];
    if (hal_get_serial(serial, sizeof(serial)) != FOTA_HAL_OK) return false;
    if (fota_register(TINYOTA_API, TINYOTA_REG_TOKEN, serial, token, sizeof(token)) != 0) {
        LOG_ERR("register failed: check TINYOTA_REG_TOKEN, network and CA");
        return false;
    }
    LOG_INF("registered as %s", serial);
    return true;
}

int main(void)
{
    LOG_INF("firmware %s", FW_VERSION);

    /* Tell MCUboot this image works, otherwise it reverts on the next
     * reset. In a real product run your self-test first. */
    if (!boot_is_img_confirmed()) {
        boot_write_img_confirmed();
    }

    tls_credential_add(FOTA_TLS_TAG, TLS_CREDENTIAL_CA_CERTIFICATE,
                       root_ca, sizeof(root_ca));

    /* Bring up your network here (LTE attach, Wi-Fi connect, ...). */

    while (!register_device()) {
        k_sleep(K_SECONDS(60));
    }

    fota_config_t cfg = {
        .server_base_url = TINYOTA_API,
        .device_token    = token,
        .current_version = FW_VERSION,
        .ram_free_kb     = 0,          /* nRF port is FULL-only */
    };
    fota_ctx_t *ctx = fota_fsm_init(&cfg);

    for (;;) {
        fota_fsm_trigger(ctx);
        while (fota_fsm_state(ctx) != FOTA_STATE_IDLE) {
            fota_fsm_run(ctx);         /* reboots inside on success */
            k_sleep(K_MSEC(20));
        }
        fota_error_t err = fota_fsm_last_error(ctx);
        if (err == FOTA_ERR_NETWORK) {
            register_device();         /* refreshes an expired token */
        } else if (err != FOTA_ERR_NO_UPDATE) {
            LOG_WRN("update failed: %d", (int)err);
        }
        k_sleep(K_HOURS(1));
    }
    return 0;
}
```

## src/tinyota_config.example.h
```c
// Copy to tinyota_config.h and fill in. Do not commit tinyota_config.h.
#pragma once

// Device API, not the web console URL.
#define TINYOTA_API          "https://api.tinyota.xyz"

// Console > Device Models > your model > registration token.
#define TINYOTA_REG_TOKEN    "paste-registration-token"

// Must match the version you type when uploading this build to the console.
// No leading "v".
#define FW_VERSION           "1.0.0"

// From https://api.tinyota.xyz/api/v1/devices/public-key ("public_key_pem").
// Keep the \n line breaks.
#define TINYOTA_PUBKEY_PEM \
    "-----BEGIN PUBLIC KEY-----\n" \
    "PASTE_BASE64_LINE_1\n" \
    "PASTE_BASE64_LINE_2\n" \
    "-----END PUBLIC KEY-----\n"

// Root CA of api.tinyota.xyz, registered at TLS tag 42 at boot. Get it with
//   openssl s_client -showcerts -connect api.tinyota.xyz:443 </dev/null
// and keep the last certificate in the chain.
#define TINYOTA_ROOT_CA_PEM \
    "-----BEGIN CERTIFICATE-----\n" \
    "PASTE_ROOT_CA\n" \
    "-----END CERTIFICATE-----\n"
```
